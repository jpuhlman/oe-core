## meta/conf/distro/include/external-toolchain.inc
```bitbake
EXTERNAL_TOOLCHAIN ??= "/usr/local/${TARGET_ARCH}"

TOOLCHAIN_PATH_ADD = "${EXTERNAL_TOOLCHAIN}/bin:"
PATH =. "${TOOLCHAIN_PATH_ADD}"

TOOLCHAIN_OPTIONS = " --sysroot=${STAGING_DIR_HOST}"

# Point to the appropriate multilib sysroot from the external toolchain, whose
# files will be extracted into the OE sysroot
def exttc_run(d, cmd):
    try:
        return bb.process.run(cmd, shell=True, env={'PATH': d.getVar('PATH', True)})[0].rstrip()
    except (OSError, bb.process.CmdError):
        return ''

EXTERNAL_TOOLCHAIN_SYSROOT_CMD = "${TARGET_PREFIX}gcc ${TARGET_CC_ARCH} -print-sysroot"
EXTERNAL_TOOLCHAIN_SYSROOT ??= "${@exttc_run(d, EXTERNAL_TOOLCHAIN_SYSROOT_CMD)}"

# Ensure we use our external toolchain recipe
PREFERRED_PROVIDER_virtual/${TARGET_PREFIX}binutils = "${TCRECIPE}"
PREFERRED_PROVIDER_virtual/${TARGET_PREFIX}gcc-initial = "${TCRECIPE}"
PREFERRED_PROVIDER_virtual/${TARGET_PREFIX}gcc-intermediate = "${TCRECIPE}"
PREFERRED_PROVIDER_virtual/${TARGET_PREFIX}gcc = "${TCRECIPE}"
PREFERRED_PROVIDER_virtual/${TARGET_PREFIX}g++ = "${TCRECIPE}"
PREFERRED_PROVIDER_virtual/${TARGET_PREFIX}compilerlibs = "${TCRECIPE}"
PREFERRED_PROVIDER_libgcc = "${TCRECIPE}"

PREFERRED_PROVIDER_linux-libc-headers = "${TCRECIPE}"
PREFERRED_PROVIDER_virtual/${TARGET_PREFIX}libc-for-gcc = "${TCRECIPE}"
PREFERRED_PROVIDER_virtual/libc = "${TCRECIPE}"
PREFERRED_PROVIDER_virtual/libintl = "${TCRECIPE}"
PREFERRED_PROVIDER_virtual/libiconv = "${TCRECIPE}"

# Verify that the exists and is hopefully sane
python toolchain_check_sanity () {
    if not isinstance(e, bb.event.ConfigParsed):
        return

    d = e.data
    l = d.createCopy()
    l.finalize()

    def error(msg):
        bb.warn(l.expand('Invalid external toolchain at ${EXTERNAL_TOOLCHAIN}: ' + msg))

    if not os.path.exists(l.expand('${EXTERNAL_TOOLCHAIN}/bin/${TARGET_PREFIX}gcc')):
        error('no ${TARGET_PREFIX}gcc found')
        return

    sysroot = l.getVar('EXTERNAL_TOOLCHAIN_SYSROOT', True)
    if not sysroot:
        error('unable to determine sysroot (-print-sysroot)')
        return

    if not os.path.exists(sysroot):
        error('sysroot "${EXTERNAL_TOOLCHAIN_SYSROOT}" does not exist')
        return
}
addhandler toolchain_check_sanity

# Extract version information from the toolchain for use in the recipe
require conf/distro/include/toolchain-versions.inc
```

## meta/conf/distro/include/tcmode-external-sourcery.inc
```bitbake
#
# Configuration to use external Sourcery G++ toolchain
#

TCRECIPE = "external-sourcery-toolchain"

PREFERRED_PROVIDER_gdbserver ??= "${TCRECIPE}"

require conf/distro/include/external-toolchain.inc

# No need to re-compile the locale files
GLIBC_INTERNAL_USE_BINARY_LOCALE = "precompiled"
ENABLE_BINARY_LOCALE_GENERATION = ""

# These bits are here temporarily to sidestep the need to use a separate set
# of tune files to pass the appropriate multilib selection arguments to the
# sourcery toolchain, and are needed to ensure the recipe picks up the files.
TUNE_FEATURES[type] = "list"

CSL_MULTILIB_ARGS[i586] = "-msgxx-glibc"
CSL_MULTILIB_ARGS[i686] = "-msgxx-glibc"
CSL_MULTILIB_ARGS[core2] = "-msgxx-glibc"
CSL_MULTILIB_ARGS[x86] = "-msgxx-glibc"
CSL_MULTILIB_ARGS[x86-64] = "-msgxx-glibc"
CSL_MULTILIB_ARGS[ppce500] = "-te500v1"
CSL_MULTILIB_ARGS[ppce500mc] = "-te500mc"
CSL_MULTILIB_ARGS[ppce500v2] = "-te500v2"
CSL_MULTILIB_ARGS[ppce600] = "-te600"

def csl_multilib_arg(d):
    argument = d.getVarFlag('CSL_MULTILIB_ARGS', d.getVar('DEFAULTTUNE', True) or '')
    if argument:
        return argument
    else:
        return ''

EXTERNAL_TOOLCHAIN_SYSROOT_CMD += "${@csl_multilib_arg(d)}"


CSL_TARGET_SYS_powerpc ?= "powerpc-linux-gnu"
CSL_TARGET_SYS_powerpc64 ?= "powerpc-linux-gnu"
CSL_TARGET_SYS_arm ?= "arm-none-linux-gnueabi"
CSL_TARGET_SYS_mips ?= "mips-linux-gnu"
CSL_TARGET_SYS_mipsel ?= "mips-linux-gnu"
CSL_TARGET_SYS_mips64 ?= "mips-linux-gnu"
CSL_TARGET_SYS_i686 ?= "i686-pc-linux-gnu"
CSL_TARGET_SYS_i586 ?= "i686-pc-linux-gnu"
CSL_TARGET_SYS = "${TARGET_SYS}"

TARGET_PREFIX = "${CSL_TARGET_SYS}-"


# Unfortunately, the CSL ia32 toolchain has non-prefixed binaries in its
# bindir (e.g. gcc, ld). To avoid this messing up our build, we avoid adding
# this bindir to our PATH, and instead add symlinks to the prefixed binaries
# to our staging toolchain bindir.
python toolchain_setup () {
    if not isinstance(e, bb.event.ConfigParsed):
        return

    d = e.data

    l = d.createCopy()
    l.finalize()

    if os.path.exists(bb.data.expand('${EXTERNAL_TOOLCHAIN}/bin/gcc', l)):
        d.setVar('TOOLCHAIN_PATH_ADD', '')
        populate_toolchain_links(d)
}
addhandler toolchain_setup

def populate_toolchain_links(d):
    import errno
    import os
    from glob import glob

    d = d.createCopy()
    d.finalize()

    pattern = d.expand('${EXTERNAL_TOOLCHAIN}/bin/${TARGET_PREFIX}*')
    files = glob(pattern)
    if not files:
        bb.fatal("Unable to populate toolchain binary symlinks in %s" % pattern)

    bindir = d.getVar('STAGING_BINDIR_TOOLCHAIN', True)
    bb.mkdirhier(bindir)
    for f in files:
        base = os.path.basename(f)
        newpath = os.path.join(bindir, base)
        try:
            os.symlink(f, newpath)
        except OSError as exc:
            if exc.errno == errno.EEXIST:
                break
            bb.fatal("Unable to populate toolchain binary symlink for %s: %s" % (newpath, exc))
```

## meta/conf/distro/include/toolchain-versions.inc
```bitbake
def toolchain_run(d, cmd, *args):
	import bb.process
	import subprocess

	topdir = d.getVar('TOPDIR', True)
	toolchain_path = d.getVar('EXTERNAL_TOOLCHAIN', True)
	if not toolchain_path:
		return 'UNKNOWN', 'UNKNOWN'

	target_prefix = d.getVar('TARGET_PREFIX', True)
	path = os.path.join(toolchain_path, 'bin', target_prefix + cmd)
	args = [path] + list(args)

	return bb.process.run(args, cwd=topdir, stderr=subprocess.PIPE)

def toolchain_version(d):
        try:
		stdout, stderr = toolchain_run(d, 'gcc', '-v')
	except bb.process.CmdError as exc:
		bb.error('Failed to obtain toolchain version: %s' % exc)
		return 'UNKNOWN'
	else:
		last_line = stderr.splitlines()[-1]
		return last_line

def toolchain_main_version(d):
	version = toolchain_version(d)
	if version != 'UNKNOWN':
		return version.split()[-1].rstrip(')')
	else:
		return version

def toolchain_gcc_version(d):
	version = toolchain_version(d)
	if version != 'UNKNOWN':
		return version.split()[2]
	else:
		return version

def toolchain_libc_version(d):
	sysroot = d.getVar('EXTERNAL_TOOLCHAIN_SYSROOT', True)
	if sysroot:
		libpath = os.path.join(sysroot, d.getVar('base_libdir', True))

		if os.path.exists(libpath):
			for file in os.listdir(libpath):
				if file.find('libc-') == 0:
					return file[5:-3]
	return 'UNKNOWN'

def toolchain_kernel_version(d):
	sysroot = d.getVar('EXTERNAL_TOOLCHAIN_SYSROOT', True)
	if not sysroot:
		return 'UNKNOWN'

	vf = os.path.join(sysroot, d.getVar('includedir', True), 'linux', 'version.h')
	try:
		f = open(vf, 'r')
	except (OSError, IOError):
		return 'UNKNOWN'

	l = f.readlines();
	f.close();
	for s in l:
		if s.find('LINUX_VERSION_CODE') > 0:
			ver = int(s.split()[2])
			maj = ver / 65536
			ver = ver % 65536
			min = ver / 256
			ver = ver % 256
			return str(maj)+'.'+str(min)+'.'+str(ver)
	return 'UNKNOWN'

def toolchain_gdb_version(d):
	try:
		stdout, stderr = toolchain_run(d, 'gdb', '-v')
	except bb.process.CmdError:
		return 'UNKNOWN'
	else:
		first_line = stdout.splitlines()[0]
		return first_line.split()[-1]

python toolchain_version_handler () {
    if not isinstance(e, bb.event.ConfigParsed):
        return
    d = e.data
    ld = d.createCopy()
    ld.finalize()

    d.setVar('TOOLCHAIN_VER_MAIN', toolchain_main_version(ld))
    d.setVar('TOOLCHAIN_VER_GCC', toolchain_gcc_version(ld))
    d.setVar('TOOLCHAIN_VER_LIBC', toolchain_libc_version(ld))
    d.setVar('TOOLCHAIN_VER_KERNEL', toolchain_kernel_version(ld))
    d.setVar('TOOLCHAIN_VER_GDB', toolchain_gdb_version(ld))
}
addhandler toolchain_version_handler

# Ensure that any variable which includes the --sysroot (CC, CXX, etc) also
# depends on the toolchain version
TOOLCHAIN_OPTIONS[vardeps] += "TOOLCHAIN_VER_MAIN TOOLCHAIN_VER_GCC"
```
